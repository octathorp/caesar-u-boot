## arch/arm/mach-rockchip/rk3128/Kconfig
```kconfig
if ROCKCHIP_RK3128

choice
	prompt "RK3128 board select"

config TARGET_EVB_RK3128
	bool "RK3128 evaluation board"
	select BOARD_LATE_INIT
	help
	  RK3128evb is a evaluation board for Rockchip rk3128,
	  with full function and phisical connectors support like
	  usb2.0 host ports, LVDS, JTAG, MAC, SDcard, HDMI, USB-2-serial...

config TARGET_WX8_RK3128
	bool "RK3128 WX8 board"
	select BOARD_LATE_INIT
	help
	  WX8 board is used in handhelds with Rockchip rk3128.
	  WX8 is used in PS5000, PowKiddy X20...
	  WX8 board:
		- Rockchip rk3128
		- 512 MB DDR3 RAM shared with GPU
		- battery power management
			- charge over USB
			- DC/DC - 5V USB (usb host), variable CPU and GPU (driven by CPU PWM), 3.3V
		- MIPI DSI display
		- HDMI output
		- SD card
		- SPI NAND (RKSFC)
		- USB OTG an USB HOST
		- stereo audio aplifier
		- game buttons and joysticks

endchoice

config SYS_SOC
	default "rockchip"

config SYS_MALLOC_F_LEN
	default 0x0800

source "board/rockchip/evb_rk3128/Kconfig"
source "board/rockchip/wx8_rk3128/Kconfig"

endif
```

## board/rockchip/wx8_rk3128/Kconfig
```kconfig
if TARGET_WX8_RK3128

config SYS_BOARD
	default "wx8_rk3128"

config SYS_VENDOR
	default "rockchip"

config SYS_CONFIG_NAME
	default "wx8_rk3128"

config BOARD_SPECIFIC_OPTIONS # dummy
	def_bool y

endif
```

## configs/powkiddy-a13-rk3128_defconfig
```kconfig
CONFIG_ARM=y
CONFIG_ARCH_ROCKCHIP=y
CONFIG_SYS_MALLOC_F_LEN=0x38000
CONFIG_ROCKCHIP_RK3128=y
# CONFIG_USING_KERNEL_DTB is not set
CONFIG_UBOOT_NUM=2
CONFIG_TRUST_SIZE_KB=1024
CONFIG_TARGET_WX8_RK3128=y
CONFIG_ARMV7_BOOT_SEC_DEFAULT=y
CONFIG_DEFAULT_DEVICE_TREE="rk3128-powkiddy-a13"
CONFIG_DEBUG_UART=y
# CONFIG_DISTRO_DEFAULTS is not set
CONFIG_SPL_SYS_MALLOC_F_LEN=0x4000
CONFIG_TPL_SYS_MALLOC_F_LEN=0x4000
CONFIG_TOOLS_DEBUG=y
CONFIG_FIT=y
CONFIG_SD_BOOT=y
CONFIG_SPI_BOOT=y
CONFIG_LOGLEVEL=7
CONFIG_LOG=y
CONFIG_LOG_MAX_LEVEL=7
# CONFIG_DISPLAY_CPUINFO is not set
CONFIG_ANDROID_BOOTLOADER=y
CONFIG_ANDROID_AVB=y
# CONFIG_SKIP_RELOCATE_UBOOT is not set
CONFIG_HUSH_PARSER=y
CONFIG_FASTBOOT_BUF_ADDR=0x60800800
CONFIG_FASTBOOT_BUF_SIZE=0x04000000
CONFIG_FASTBOOT_FLASH=y
CONFIG_FASTBOOT_FLASH_MMC_DEV=0
CONFIG_CMD_BOOTZ=y
CONFIG_CMD_DTIMG=y
# CONFIG_CMD_IMLS is not set
# CONFIG_CMD_FPGA is not set
CONFIG_CMD_GPT=y
CONFIG_CMD_BOOT_ANDROID=y
CONFIG_CMD_BOOT_ROCKCHIP=y
CONFIG_CMD_MMC=y
CONFIG_CMD_PART=y
CONFIG_CMD_USB=y
CONFIG_CMD_USB_MASS_STORAGE=y
# CONFIG_CMD_SETEXPR is not set
# CONFIG_CMD_NET is not set
CONFIG_CMD_DHCP=y
CONFIG_CMD_PXE=y
# CONFIG_CMD_NFS is not set
CONFIG_CMD_MII=y
CONFIG_CMD_PING=y
CONFIG_CMD_BMP=y
CONFIG_CMD_TIME=y
CONFIG_CMD_EXT2=y
CONFIG_CMD_EXT4=y
CONFIG_CMD_FAT=y
CONFIG_CMD_FS_GENERIC=y
CONFIG_EFI_PARTITION_ENTRIES_NUMBERS=64
CONFIG_RKPARM_PARTITION=y
CONFIG_OF_LIVE=y
CONFIG_REGMAP=y
CONFIG_SYSCON=y
CONFIG_DEVRES=y
CONFIG_DEBUG_DEVRES=y
CONFIG_CLK=y
CONFIG_ROCKCHIP_GPIO=y
CONFIG_SYS_I2C_ROCKCHIP=y
CONFIG_DM_KEY=y
CONFIG_ADC_KEY=y
CONFIG_GPIO_KEY=y
CONFIG_RK_KEY=y
CONFIG_MMC_DW=y
CONFIG_MMC_DW_ROCKCHIP=y
CONFIG_PHY_ROCKCHIP_INNO_USB2=y
CONFIG_PINCTRL=y
CONFIG_DM_FUEL_GAUGE=y
CONFIG_REGULATOR_PWM=y
CONFIG_DM_REGULATOR_FIXED=y
CONFIG_PWM_ROCKCHIP=y
CONFIG_RAM=y
CONFIG_ROCKCHIP_DMC=y
CONFIG_DM_RESET=y
CONFIG_RKFLASH=y
CONFIG_RKSFC_NAND=y
CONFIG_DEBUG_UART_BASE=0x20060000
CONFIG_DEBUG_UART_CLOCK=24000000
CONFIG_DEBUG_UART_SHIFT=2
CONFIG_DEBUG_UART_ANNOUNCE=y
CONFIG_ROCKCHIP_SFC=y
CONFIG_SYSRESET=y
# CONFIG_SYSRESET_PSCI is not set
CONFIG_USB=y
CONFIG_USB_EHCI_HCD=y
CONFIG_USB_EHCI_GENERIC=y
CONFIG_USB_OHCI_HCD=y
CONFIG_USB_OHCI_GENERIC=y
CONFIG_USB_DWC2=y
CONFIG_USB_STORAGE=y
CONFIG_USB_GADGET=y
CONFIG_USB_GADGET_MANUFACTURER="Rockchip"
CONFIG_USB_GADGET_VENDOR_NUM=0x2207
CONFIG_USB_GADGET_PRODUCT_NUM=0x310c
CONFIG_USB_GADGET_DWC2_OTG=y
CONFIG_USB_GADGET_DOWNLOAD=y
CONFIG_DM_VIDEO=y
CONFIG_DISPLAY=y
CONFIG_VIDEO_ROCKCHIP=y
CONFIG_DISPLAY_ROCKCHIP_MIPI=y
CONFIG_DRM_ROCKCHIP=y
CONFIG_DRM_ROCKCHIP_INNO_VIDEO_COMBO_PHY=y
CONFIG_DRM_ROCKCHIP_RGB=y
CONFIG_LCD=y
CONFIG_USE_TINY_PRINTF=y
CONFIG_REGEX=y
CONFIG_ERRNO_STR=y
# CONFIG_EFI_LOADER is not set
CONFIG_AVB_LIBAVB=y
CONFIG_AVB_LIBAVB_AB=y
CONFIG_AVB_LIBAVB_ATX=y
CONFIG_AVB_LIBAVB_USER=y
CONFIG_RK_AVB_LIBAVB_USER=y
CONFIG_TEST_ROCKCHIP=y
```
